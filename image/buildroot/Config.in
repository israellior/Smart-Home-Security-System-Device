## image/buildroot/Config.in
```kconfig
# Menu entries for our own packages, shown under "External options" in
# menuconfig. One line per package.

source "$BR2_EXTERNAL_PORCHLIGHT_PATH/package/porchlightd/Config.in"
source "$BR2_EXTERNAL_PORCHLIGHT_PATH/package/porchlight-boot/Config.in"
source "$BR2_EXTERNAL_PORCHLIGHT_PATH/package/porchlight-recorder/Config.in"
source "$BR2_EXTERNAL_PORCHLIGHT_PATH/package/python-ai-edge-litert/Config.in"
source "$BR2_EXTERNAL_PORCHLIGHT_PATH/package/porchlight-detect/Config.in"
source "$BR2_EXTERNAL_PORCHLIGHT_PATH/package/porchlight-face-models/Config.in"
source "$BR2_EXTERNAL_PORCHLIGHT_PATH/package/python-livekit/Config.in"
source "$BR2_EXTERNAL_PORCHLIGHT_PATH/package/porchlight-call/Config.in"
source "$BR2_EXTERNAL_PORCHLIGHT_PATH/package/porchlight-ab/Config.in"
```

## image/buildroot/configs/porchlight_rpi4_defconfig
```kconfig
BR2_aarch64=y
BR2_cortex_a72=y
BR2_ARM_FPU_VFPV4=y
BR2_TOOLCHAIN_EXTERNAL=y
BR2_TOOLCHAIN_EXTERNAL_BOOTLIN=y
BR2_GLOBAL_PATCH_DIR="$(BR2_EXTERNAL_PORCHLIGHT_PATH)/board/porchlight/rpi4/patches"
BR2_DOWNLOAD_FORCE_CHECK_HASHES=y
BR2_TARGET_GENERIC_HOSTNAME="porchlight"
BR2_TARGET_GENERIC_ISSUE="Welcome to Porchlight"
BR2_INIT_SYSTEMD=y
BR2_TARGET_GENERIC_ROOT_PASSWD="$$6$$fM9eioctZfdAMzXa$$u1rw1/T.7POjGV6yfcbUltBNRCLdHCbka74mA7bXfb0ImPnPCPL43BQ./nujJf6fIMq7mnGlz7mtQSOHoJkiv/"
# BR2_TARGET_GENERIC_REMOUNT_ROOTFS_RW is not set
BR2_ROOTFS_OVERLAY="$(BR2_EXTERNAL_PORCHLIGHT_PATH)/board/porchlight/rpi4/rootfs-overlay"
BR2_ROOTFS_POST_BUILD_SCRIPT="$(BR2_EXTERNAL_PORCHLIGHT_PATH)/board/porchlight/rpi4/post-build.sh"
BR2_ROOTFS_POST_IMAGE_SCRIPT="$(BR2_EXTERNAL_PORCHLIGHT_PATH)/board/porchlight/rpi4/post-image.sh"
BR2_LINUX_KERNEL=y
BR2_LINUX_KERNEL_CUSTOM_TARBALL=y
BR2_LINUX_KERNEL_CUSTOM_TARBALL_LOCATION="$(call github,raspberrypi,linux,21b410140c47ffab5668399f6f143c7d7b935c8b)/linux-21b410140c47ffab5668399f6f143c7d7b935c8b.tar.gz"
BR2_LINUX_KERNEL_DEFCONFIG="bcm2711"
BR2_LINUX_KERNEL_DTS_SUPPORT=y
BR2_LINUX_KERNEL_INTREE_DTS_NAME="broadcom/bcm2711-rpi-4-b broadcom/bcm2711-rpi-400 broadcom/bcm2711-rpi-cm4 broadcom/bcm2711-rpi-cm4s"
BR2_LINUX_KERNEL_INSTALL_TARGET=y
BR2_LINUX_KERNEL_NEEDS_HOST_OPENSSL=y
BR2_PACKAGE_GSTREAMER1=y
BR2_PACKAGE_GST1_PLUGINS_GOOD=y
BR2_PACKAGE_GST1_PLUGINS_BAD=y
BR2_PACKAGE_GST1_PLUGINS_UGLY=y
BR2_PACKAGE_GST1_LIBAV=y
BR2_PACKAGE_GST1_PYTHON=y
BR2_PACKAGE_XZ=y
BR2_PACKAGE_BRCMFMAC_SDIO_FIRMWARE_RPI=y
BR2_PACKAGE_BRCMFMAC_SDIO_FIRMWARE_RPI_WIFI=y
BR2_PACKAGE_RPI_FIRMWARE=y
BR2_PACKAGE_RPI_FIRMWARE_VARIANT_PI4=y
BR2_PACKAGE_RPI_FIRMWARE_CONFIG_FILE="$(BR2_EXTERNAL_PORCHLIGHT_PATH)/board/porchlight/rpi4/config.txt"
BR2_PACKAGE_RPI_FIRMWARE_CMDLINE_FILE="$(BR2_EXTERNAL_PORCHLIGHT_PATH)/board/porchlight/rpi4/cmdline.txt"
BR2_PACKAGE_LIBCAMERA=y
BR2_PACKAGE_DROPBEAR=y
BR2_PACKAGE_NETWORK_MANAGER=y
BR2_PACKAGE_NETWORK_MANAGER_CLI=y
BR2_PACKAGE_WIRELESS_REGDB=y
BR2_PACKAGE_WPA_SUPPLICANT=y
BR2_PACKAGE_WPA_SUPPLICANT_AP_SUPPORT=y
BR2_PACKAGE_WPA_SUPPLICANT_DBUS=y
BR2_PACKAGE_RAUC=y
# BR2_PACKAGE_SYSTEMD_NETWORKD is not set
BR2_TARGET_ROOTFS_EXT2=y
BR2_TARGET_ROOTFS_EXT2_4=y
BR2_TARGET_ROOTFS_EXT2_SIZE="512M"
# BR2_TARGET_ROOTFS_TAR is not set
BR2_TARGET_UBOOT=y
BR2_TARGET_UBOOT_BUILD_SYSTEM_KCONFIG=y
BR2_TARGET_UBOOT_CUSTOM_VERSION=y
BR2_TARGET_UBOOT_CUSTOM_VERSION_VALUE="2024.01"
BR2_TARGET_UBOOT_BOARD_DEFCONFIG="rpi_4"
BR2_PACKAGE_HOST_DOSFSTOOLS=y
BR2_PACKAGE_HOST_GENIMAGE=y
BR2_PACKAGE_HOST_KMOD_XZ=y
BR2_PACKAGE_HOST_MTOOLS=y
BR2_PACKAGE_HOST_RAUC=y
BR2_PACKAGE_HOST_UBOOT_TOOLS=y
BR2_PACKAGE_HOST_UBOOT_TOOLS_BOOT_SCRIPT=y
BR2_PACKAGE_HOST_UBOOT_TOOLS_BOOT_SCRIPT_SOURCE="$(BR2_EXTERNAL_PORCHLIGHT_PATH)/board/porchlight/rpi4/boot.cmd"
BR2_PACKAGE_PORCHLIGHTD=y
BR2_PACKAGE_PORCHLIGHT_BOOT=y
BR2_PACKAGE_PORCHLIGHT_RECORDER=y
BR2_PACKAGE_PYTHON_LIVEKIT=y
BR2_PACKAGE_PORCHLIGHT_CALL=y
BR2_PACKAGE_PORCHLIGHT_AB=y
```

## image/buildroot/package/porchlight-ab/Config.in
```kconfig
config BR2_PACKAGE_PORCHLIGHT_AB
	bool "porchlight-ab"
	depends on BR2_INIT_SYSTEMD
	depends on BR2_PACKAGE_PORCHLIGHTD    # the health check watches it
	depends on BR2_TARGET_UBOOT           # boot.scr does the choosing
	depends on BR2_PACKAGE_RAUC
	# RAUC's U-Boot backend changes the boot order through fw_setenv.
	select BR2_PACKAGE_UBOOT_TOOLS
	select BR2_PACKAGE_UBOOT_TOOLS_FWPRINTENV
	help
	  A/B system updates: RAUC's description of the two slots, the U-Boot
	  environment it steers them through, the data partition that every
	  update leaves alone, a health check that marks a booted slot good or
	  falls back from it, and the hardware watchdog.

comment "porchlight-ab needs systemd, porchlightd, U-Boot and RAUC"
	depends on !BR2_INIT_SYSTEMD || !BR2_PACKAGE_PORCHLIGHTD || \
		!BR2_TARGET_UBOOT || !BR2_PACKAGE_RAUC
```
